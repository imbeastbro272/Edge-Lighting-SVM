/*
 * SVM.ino  -  ESP32 Edge-Lighting controller using a locally-running
 *             Support Vector Regression model.
 *
 * This sketch is the minimal counterpart to DT.ino. Instead of including
 * a Decision Tree header (tree_rules.h) it includes svm_model.h, which is
 * generated by:
 *   "3 PYTHON PROGRAM SVM MODEL TRAINING WITH HYPERPARAMETER TUNING.py"
 *
 * No Wi-Fi, no cloud, no Python at runtime - the trained SVM lives entirely
 * in flash (support vectors + scaler params + intercept + gamma) and runs
 * on-device via svm_predict_brightness().
 *
 * Wiring (matches DT.ino):
 *   PIR sensor   -> GPIO 27
 *   LDR (analog) -> GPIO 34   (ADC1_CH6)
 *   POT (manual) -> GPIO 33   (ADC1_CH5, optional override)
 *   LED / driver -> GPIO 2    (PWM)
 *   DS3231 RTC   -> I2C (SDA/SCL default)
 *
 * To regenerate the model:
 *   1. Re-run the Python training script in Colab.
 *   2. Replace svm_model.h in this sketch folder with the new one.
 *   3. Re-flash. No code changes here are required as long as the feature
 *      order does not change.
 */

#include <Wire.h>
#include <RTClib.h>
#include <math.h>

#include "svm_model.h"   // <-- generated by the Python training script

// ============================================
// PIN DEFINITIONS
// ============================================
#define PIR_PIN  27
#define LDR_PIN  34
#define POT_PIN  33
#define LED_PIN  2

// ============================================
// CONFIGURATION
// ============================================
#define UPDATE_INTERVAL_MS   1000
#define POT_OVERRIDE_DELTA   200      // raw ADC counts; if pot moved more than
                                      // this from the model output, treat the
                                      // user's pot value as a manual override.

// PWM
// We use plain analogWrite() to stay compatible with both ESP32 Arduino
// Core 2.x and 3.x (the 3.x release renamed ledcSetup / ledcAttachPin to
// ledcAttach, which broke the old API). analogWrite() on ESP32 wraps LEDC
// internally and is also what DT.ino uses, so the two sketches behave the
// same way at the pin.
#define LED_PWM_RANGE        255      // analogWrite() default duty range

// LDR -> lux conversion. Tune for your divider; the same constant must be
// used when training (i.e. the CSV's ambient_light_lux column should be the
// output of THIS conversion).
static float ldr_to_lux(int adc_raw) {
    // Simple linear placeholder. Replace with your calibration curve.
    // adc_raw is 0..4095 on ESP32 ADC.
    return (float)adc_raw * (SVM_MAX_LUX / 4095.0f);
}

// ============================================
// TIME-OF-DAY -> period index
// The macros TOD_* are defined in svm_model.h based on the LabelEncoder
// classes seen at training time. Defaults below cover the typical 5-bucket
// scheme; if your training data uses different strings, just adjust the
// thresholds (the macro names will match your data).
// ============================================
static int hour_to_period(int hour) {
#if defined(TOD_NIGHT) && defined(TOD_EARLY_MORNING) && defined(TOD_MORNING) \
 && defined(TOD_AFTERNOON) && defined(TOD_EVENING)
    if (hour >= 0  && hour < 5)  return TOD_NIGHT;
    if (hour >= 5  && hour < 8)  return TOD_EARLY_MORNING;
    if (hour >= 8  && hour < 12) return TOD_MORNING;
    if (hour >= 12 && hour < 17) return TOD_AFTERNOON;
    if (hour >= 17 && hour < 21) return TOD_EVENING;
    return TOD_NIGHT;
#else
    // Fallback: training data used a different label set. Use 0 and check
    // svm_model.h for the actual TOD_* macros, then update this function.
    (void)hour;
    return 0;
#endif
}

// ============================================
// RTC
// ============================================
RTC_DS3231 rtc;
bool rtc_ok = false;

// ============================================
// SETUP
// ============================================
void setup() {
    Serial.begin(115200);
    delay(200);

    Serial.println();
    Serial.println(F("====================================================="));
    Serial.println(F(" ESP32 Edge-Lighting - on-device SVM inference"));
    Serial.println(F("====================================================="));
    Serial.print  (F(" SVM_N_FEATURES : ")); Serial.println(SVM_N_FEATURES);
    Serial.print  (F(" SVM_N_SV       : ")); Serial.println(SVM_N_SV);
    Serial.print  (F(" SVM_KERNEL_RBF : ")); Serial.println(SVM_KERNEL_RBF);
    Serial.print  (F(" SVM_GAMMA      : ")); Serial.println(SVM_GAMMA, 6);
    Serial.print  (F(" SVM_MAX_LUX    : ")); Serial.println(SVM_MAX_LUX, 2);

    pinMode(PIR_PIN, INPUT);
    pinMode(LED_PIN, OUTPUT);
    pinMode(LDR_PIN, INPUT);
    pinMode(POT_PIN, INPUT);

    Wire.begin();
    if (rtc.begin()) {
        rtc_ok = true;
        if (rtc.lostPower()) {
            // Set to compile time once if the RTC has lost power.
            rtc.adjust(DateTime(F(__DATE__), F(__TIME__)));
        }
    } else {
        Serial.println(F(" [warn] DS3231 not found - using millis() hour=12"));
    }
}

// ============================================
// LOOP
// ============================================
void loop() {
    static uint32_t last_update = 0;
    uint32_t now = millis();
    if (now - last_update < UPDATE_INTERVAL_MS) return;
    last_update = now;

    // ---- Read sensors ----
    int   ldr_raw = analogRead(LDR_PIN);
    float lux     = ldr_to_lux(ldr_raw);
    int   motion  = digitalRead(PIR_PIN) == HIGH ? 1 : 0;
    int   pot_raw = analogRead(POT_PIN);

    // ---- Time features ----
    int hour = 12;
    int minute = 0;
    if (rtc_ok) {
        DateTime t = rtc.now();
        hour   = t.hour();
        minute = t.minute();
    }
    float frac_hour = (float)hour + (float)minute / 60.0f;
    float sin_h = sinf(2.0f * (float)M_PI * frac_hour / 24.0f);
    float cos_h = cosf(2.0f * (float)M_PI * frac_hour / 24.0f);
    int   period = hour_to_period(hour);

    // ---- Run on-device SVM ----
    float intensity_pct = svm_predict_brightness(lux, motion, sin_h, cos_h, period);
    int   pwm_value     = (int)roundf(intensity_pct * 255.0f / 100.0f);
    if (pwm_value < 0)   pwm_value = 0;
    if (pwm_value > 255) pwm_value = 255;

    // ---- Optional: pot override ----
    // Convert pot to a 0..255 "user requested" PWM and check whether the user
    // is actively turning the knob (i.e. far from the model's output).
    int pot_pwm = map(pot_raw, 0, 4095, 0, 255);
    if (abs(pot_pwm - pwm_value) > POT_OVERRIDE_DELTA) {
        pwm_value = pot_pwm;   // honour the human
    }

    analogWrite(LED_PIN, pwm_value);

    // ---- Telemetry ----
    Serial.print(F("h=")); Serial.print(hour);
    Serial.print(F(":")); if (minute < 10) Serial.print('0'); Serial.print(minute);
    Serial.print(F(" lux="));    Serial.print(lux, 1);
    Serial.print(F(" motion=")); Serial.print(motion);
    Serial.print(F(" period=")); Serial.print(period);
    Serial.print(F(" -> svm=")); Serial.print(intensity_pct, 1);
    Serial.print(F("%  pwm="));  Serial.println(pwm_value);
}
