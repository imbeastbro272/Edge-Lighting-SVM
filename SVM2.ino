/*
 * LED Brightness Controller with KNN-BASED INCREMENTAL LEARNING (TIME-LOCAL)
 * Base predictor: SUPPORT VECTOR REGRESSION (frozen, on-device)
 *
 * APPROACH:
 *   - The pre-trained SVR model stays FROZEN as the base predictor
 *     (svm_model.h, generated by the Python training script). It is never
 *     modified at runtime.
 *   - User feedback samples are stored in EEPROM and mirrored to a RAM cache.
 *   - On every prediction we apply a HARD time/day gate before any KNN math:
 *       eligible(sample) := (sample.day_of_week == current.day_of_week
 *                              AND |sample.minute_of_day - current.minute_of_day| <= window)
 *                        OR (midnight bridge: adjacent day-of-week, BOTH endpoints
 *                              within `window` minutes of 00:00).
 *     Samples outside the gate contribute NOTHING. They cannot leak into
 *     other hours of the day or into other days of the week.
 *     The midnight bridge means Sat 23:55 <-> Sun 00:05 IS matched; Sat 23:55
 *     <-> Sun 12:00 IS NOT.
 *   - Among eligible samples, the correction is a Gaussian-kernel weighted
 *     average of (target - svm_at_sample) using ambient + motion as the
 *     distance features (time/day are already equal by virtue of the gate).
 *
 * PIPELINE per prediction:
 *   1. svm_pred = svm_predict_brightness(features)
 *   2. eligible  = filter(samples, same day AND |dt| <= window)
 *   3. if eligible empty -> return svm_pred (no correction at all)
 *   4. for each eligible sample:
 *        residual_i = target_i - svm_pred(sample_i)
 *        dist_i^2   = w_amb*(d_amb/scale)^2 + w_mot*(d_mot)^2
 *   5. take K nearest by dist^2
 *   6. correction = sum(w_i * residual_i) / sum(w_i)
 *      where w_i  = exp(-dist_i^2 / (2*sigma_kernel^2))
 *   7. confidence = exp(-min_dist^2 / (2*sigma_confidence^2))
 *   8. final = clamp(svm_pred + confidence * correction, 0, 100)
 *
 * SAMPLE STORAGE FIELDS (24 bytes per sample):
 *   ambient_light, motion_detected, day_of_week, minute_of_day,
 *   target_brightness, timestamp
 *
 *   sin_hour, cos_hour, time_period are NOT stored anymore -
 *   they are recomputed from minute_of_day when needed (i.e. when feeding
 *   a stored sample back into the SVM to compute its residual).
 *
 * COMMANDS:
 *   help, stats, samples, modelinfo, knninfo
 *   clearsamples     - wipe samples only (keeps K, sigma, window)
 *   resetmodel       - wipe samples AND restore default K/sigma/window
 *   setk N           - K neighbors (1..MAX_TRAINING_SAMPLES)
 *   setsigma X       - kernel bandwidth (>0)
 *   setwindow N      - time gate window in minutes (1..720)
 *   addsample HH DD AMBIENT MOTION BRIGHTNESS              (minute = 0)
 *   addsample HH MM DD AMBIENT MOTION BRIGHTNESS           (with minute)
 *   test HH DD AMBIENT MOTION POT                          (minute = 0)
 *   test HH MM DD AMBIENT MOTION POT                       (with minute)
 */

#include <Wire.h>
#include <RTClib.h>
#include <EEPROM.h>
#include <math.h>
#include "svm_model.h"
#include "utility_agent.h"   // NON-ML AI layer (advisory utility-based agent)

// ============================================
// PIN DEFINITIONS
// ============================================

#define PIR_PIN 27
#define LDR_PIN 34
#define POT_PIN 33
#define LED_PIN 2

// ============================================
// CONFIGURATION
// ============================================

#define UPDATE_INTERVAL    1000
#define SMOOTHING_FACTOR   0.7
#define POT_DEADZONE       200

#define LEARNING_ENABLED   true

#define POT_STABLE_DURATION    5000
#define POT_CHANGE_THRESHOLD   50

#define EEPROM_SIZE        4096

// ============================================
// FEATURE WEIGHTS (within-gate KNN distance)
// Only ambient + motion participate now; time and day are gated.
// Kept identical to DT.ino so KNN behaviour stays the same regardless of
// which base predictor (DT or SVM) is in use.
// ============================================

#define IMPORTANCE_AMBIENT   0.254848f
#define IMPORTANCE_MOTION    0.229156f

// Lux normalisation scale for distance metric
#define AMBIENT_SCALE        1000.0f

// ============================================
// EEPROM LAYOUT
// ============================================

#define EEPROM_SAMPLE_COUNT_ADDR    0    // int (4 bytes)
#define EEPROM_NEXT_WRITE_IDX_ADDR  4    // int (4 bytes)
#define EEPROM_KNN_CONFIG_ADDR      8    // KnnConfig (20 bytes)
#define EEPROM_SAMPLES_MAGIC_ADDR   28   // uint32_t (4 bytes) - sample-format version magic
#define EEPROM_SAMPLES_START        100

// Magic numbers identify storage format; mismatch triggers safe re-init.
#define KNN_CONFIG_MAGIC      0xC0FFEE02
#define SAMPLES_FORMAT_MAGIC  0xBEEF0002

// ============================================
// TRAINING SAMPLE STORAGE
// ============================================

#define MAX_TRAINING_SAMPLES   100
#define SAMPLE_SIZE            24    // sizeof(TrainingSample) - keep in sync!

struct TrainingSample {
  float    ambient_light;     // 4
  int      motion_detected;   // 4
  int      day_of_week;       // 4   (0=Mon .. 6=Sun)
  int      minute_of_day;     // 4   (0..1439)
  float    target_brightness; // 4
  uint32_t timestamp;         // 4
};                            // total: 24

TrainingSample samples_cache[MAX_TRAINING_SAMPLES];

int training_sample_count = 0;
int next_write_idx        = 0;

// ============================================
// KNN CONFIG (persisted)
// ============================================

struct KnnConfig {
  int      k_neighbors;       // 4
  float    sigma_kernel;      // 4
  float    sigma_confidence;  // 4
  int      time_window_min;   // 4   - same day + |dt| <= this many minutes
  uint32_t magic;             // 4
};                            // total: 20

KnnConfig knn_cfg;

// ============================================
// MANUAL INPUT MODE
// ============================================

bool manual_input_mode = false;

// ============================================
// RTC
// ============================================

RTC_DS3231 rtc;

// ============================================
// STATE VARIABLES
// ============================================

float smoothed_ldr        = 0;
float smoothed_brightness = 0;
int   manual_offset       = 0;
unsigned long last_update = 0;

// ============================================
// POT CHANGE TRACKING (for sample capture)
// ============================================

int  last_stable_pot_value     = -1;
int  current_pot_candidate     = -1;
unsigned long pot_stable_start = 0;
bool pot_candidate_active      = false;
int  pot_change_count_today    = 0;
int  last_check_day            = -1;

// ============================================
// STATS
// ============================================

unsigned long prediction_count = 0;
float avg_brightness           = 0;

// ============================================
// NON-ML AI LAYER (Utility-Based Agent) - state
// Kept entirely separate from the SVM-KNN pipeline. Config lives in RAM
// (see utility_agent.h, g_util_cfg); the EEPROM layout used by SVM-KNN is
// NOT touched.
// ============================================

UtilityResult g_util_result = { false };
float util_prev_brightness  = 0.0f;
bool  util_apply            = false;   // false = advisory only (SVM-KNN drives LED)

// ============================================
// FORWARD DECLARATIONS
// ============================================

float predict_knn(float ambient, int motion, int hour_of_day, int minute_in_hour,
                  int day,
                  float *out_svm_pred, float *out_correction,
                  float *out_confidence, float *out_min_dist,
                  int *out_neighbors_used, int *out_eligible_count);
float readLDR();
int   readManualOffset();
int   getTimePeriod(int hour);
void  printDateTime(DateTime dt);
void  handleSerialCommand();
void  monitorPotForSampleCapture(unsigned long current_time, float ml_pred, float user_brightness);
void  checkDailyRollover(DateTime &now);
static inline void sampleSvmFeatures(const TrainingSample &s,
                                     float *sin_h, float *cos_h, int *period);

// ============================================
// EEPROM / CACHE MANAGEMENT
// ============================================

void wipeAllSamples() {
  training_sample_count = 0;
  next_write_idx        = 0;
  EEPROM.put(EEPROM_SAMPLE_COUNT_ADDR,   training_sample_count);
  EEPROM.put(EEPROM_NEXT_WRITE_IDX_ADDR, next_write_idx);
  uint32_t magic = SAMPLES_FORMAT_MAGIC;
  EEPROM.put(EEPROM_SAMPLES_MAGIC_ADDR, magic);
  EEPROM.commit();
}

void loadSamplesFromEEPROM() {
  for (int i = 0; i < training_sample_count; i++) {
    int addr = EEPROM_SAMPLES_START + (i * SAMPLE_SIZE);
    EEPROM.get(addr, samples_cache[i]);
  }
  Serial.print(F("[cache] Loaded "));
  Serial.print(training_sample_count);
  Serial.println(F(" sample(s) into RAM"));
}

void initializeTrainingStorage() {
  // Check sample-format magic; on mismatch the on-disk samples are from a
  // previous firmware version with a different struct layout - wipe them.
  uint32_t magic_on_disk = 0;
  EEPROM.get(EEPROM_SAMPLES_MAGIC_ADDR, magic_on_disk);

  if (magic_on_disk != SAMPLES_FORMAT_MAGIC) {
    Serial.println(F("[storage] Sample format changed - wiping old samples"));
    wipeAllSamples();
  } else {
    EEPROM.get(EEPROM_SAMPLE_COUNT_ADDR,   training_sample_count);
    EEPROM.get(EEPROM_NEXT_WRITE_IDX_ADDR, next_write_idx);

    if (training_sample_count < 0 || training_sample_count > MAX_TRAINING_SAMPLES) {
      training_sample_count = 0;
      next_write_idx        = 0;
      EEPROM.put(EEPROM_SAMPLE_COUNT_ADDR,   training_sample_count);
      EEPROM.put(EEPROM_NEXT_WRITE_IDX_ADDR, next_write_idx);
      EEPROM.commit();
    }
    if (next_write_idx < 0 || next_write_idx >= MAX_TRAINING_SAMPLES) {
      next_write_idx = training_sample_count % MAX_TRAINING_SAMPLES;
      EEPROM.put(EEPROM_NEXT_WRITE_IDX_ADDR, next_write_idx);
      EEPROM.commit();
    }
  }

  Serial.print(F("Training samples in EEPROM: "));
  Serial.println(training_sample_count);

  loadSamplesFromEEPROM();
}

void saveTrainingSample(const TrainingSample &sample) {
  int slot = next_write_idx;

  samples_cache[slot] = sample;

  int addr = EEPROM_SAMPLES_START + (slot * SAMPLE_SIZE);
  EEPROM.put(addr, sample);

  next_write_idx = (next_write_idx + 1) % MAX_TRAINING_SAMPLES;
  if (training_sample_count < MAX_TRAINING_SAMPLES) {
    training_sample_count++;
  }

  EEPROM.put(EEPROM_SAMPLE_COUNT_ADDR,   training_sample_count);
  EEPROM.put(EEPROM_NEXT_WRITE_IDX_ADDR, next_write_idx);
  EEPROM.commit();

  Serial.print(F("[v] Sample stored. Total in memory: "));
  Serial.println(training_sample_count);
}

TrainingSample loadTrainingSample(int index) {
  return samples_cache[index];
}

void captureTrainingSample(float svm_pred, float user_brightness) {
  DateTime now = rtc.now();

  TrainingSample sample;
  sample.ambient_light     = smoothed_ldr;
  sample.motion_detected   = digitalRead(PIR_PIN);
  sample.day_of_week       = (now.dayOfTheWeek() + 6) % 7;          // 0=Mon
  sample.minute_of_day     = now.hour() * 60 + now.minute();        // RTC precision
  sample.target_brightness = user_brightness;
  sample.timestamp         = now.unixtime();

  saveTrainingSample(sample);

  Serial.print(F("[capture] "));
  Serial.print(now.hour()); Serial.print(F(":"));
  if (now.minute() < 10) Serial.print('0');
  Serial.print(now.minute());
  Serial.print(F("  Ambient="));
  Serial.print(sample.ambient_light);
  Serial.print(F(" SVM="));
  Serial.print(svm_pred);
  Serial.print(F("% User="));
  Serial.print(user_brightness);
  Serial.println(F("%"));
}

void addManualSample(int hour, int minute, int day, float ambient, int motion, float target_brightness) {
  TrainingSample sample;
  sample.ambient_light     = ambient;
  sample.motion_detected   = motion;
  sample.day_of_week       = day;
  sample.minute_of_day     = hour * 60 + minute;
  sample.target_brightness = target_brightness;
  sample.timestamp         = rtc.now().unixtime();

  saveTrainingSample(sample);

  const char *day_names[] = {"Mon", "Tue", "Wed", "Thu", "Fri", "Sat", "Sun"};
  Serial.println();
  Serial.println(F("[v] MANUAL SAMPLE ADDED"));
  Serial.print(F("    Time: "));
  Serial.print(hour);
  Serial.print(F(":"));
  if (minute < 10) Serial.print('0');
  Serial.print(minute);
  Serial.print(F("  Day: "));
  Serial.println(day_names[day]);
  Serial.print(F("    Ambient: "));
  Serial.print(ambient);
  Serial.print(F(" lux, Motion: "));
  Serial.println(motion ? "YES" : "NO");
  Serial.print(F("    Target Brightness: "));
  Serial.print(target_brightness);
  Serial.println(F("%"));
  Serial.println();
}

// ============================================
// KNN CONFIG (persistence)
// ============================================

void initializeKnnConfig() {
  knn_cfg.k_neighbors      = 5;
  knn_cfg.sigma_kernel     = 0.25f;
  knn_cfg.sigma_confidence = 0.40f;
  knn_cfg.time_window_min  = 10;       // +/- 10 minutes default
  knn_cfg.magic            = KNN_CONFIG_MAGIC;
}

void saveKnnConfig() {
  EEPROM.put(EEPROM_KNN_CONFIG_ADDR, knn_cfg);
  EEPROM.commit();
}

void loadKnnConfig() {
  EEPROM.get(EEPROM_KNN_CONFIG_ADDR, knn_cfg);
  bool valid = (knn_cfg.magic == KNN_CONFIG_MAGIC) &&
               (knn_cfg.k_neighbors      >= 1) &&
               (knn_cfg.k_neighbors      <= MAX_TRAINING_SAMPLES) &&
               (knn_cfg.sigma_kernel     >  0.0f) &&
               (knn_cfg.sigma_confidence >  0.0f) &&
               (knn_cfg.time_window_min  >= 1) &&
               (knn_cfg.time_window_min  <= 720);

  if (!valid) {
    Serial.println(F("[knn] No valid saved config, using defaults"));
    initializeKnnConfig();
    saveKnnConfig();
  } else {
    Serial.print(F("[knn] Loaded config: K="));
    Serial.print(knn_cfg.k_neighbors);
    Serial.print(F(" sigma_k="));
    Serial.print(knn_cfg.sigma_kernel, 3);
    Serial.print(F(" sigma_c="));
    Serial.print(knn_cfg.sigma_confidence, 3);
    Serial.print(F(" window=+/-"));
    Serial.print(knn_cfg.time_window_min);
    Serial.println(F(" min"));
  }
}

// ============================================
// HELPER: derive SVM-input features from a stored sample
// ============================================

static inline void sampleSvmFeatures(const TrainingSample &s,
                                     float *sin_h, float *cos_h, int *period) {
  int hour = s.minute_of_day / 60;          // hour bucket for cyclic encoding
  *sin_h  = sin(2.0 * PI * hour / 24.0);
  *cos_h  = cos(2.0 * PI * hour / 24.0);
  *period = getTimePeriod(hour);
}

// ============================================
// KNN DISTANCE METRIC (within-gate features only)
// ============================================

static inline float knnDistanceSq(float a_amb, int a_mot,
                                  float b_amb, int b_mot) {
  float d_amb = (a_amb - b_amb) / AMBIENT_SCALE;
  float d_mot = (float)(a_mot - b_mot);
  return  IMPORTANCE_AMBIENT * d_amb * d_amb
        + IMPORTANCE_MOTION  * d_mot * d_mot;
}

// ============================================
// KNN PREDICTION (SVM + Local Residual Correction)
//
// Hard time/day gate is applied first; samples outside the gate are NOT
// considered, so they cannot influence predictions in any other neighborhood.
// ============================================

float predict_knn(float ambient, int motion, int hour_of_day, int minute_in_hour,
                  int day,
                  float *out_svm_pred, float *out_correction,
                  float *out_confidence, float *out_min_dist,
                  int *out_neighbors_used, int *out_eligible_count) {

  float sin_h    = sin(2.0 * PI * hour_of_day / 24.0);
  float cos_h    = cos(2.0 * PI * hour_of_day / 24.0);
  int   period   = getTimePeriod(hour_of_day);
  int   cur_mod  = hour_of_day * 60 + minute_in_hour;

  // 1. Frozen SVM base predictor
  //    NOTE: the SVM model has no day_of_week feature (it was trained on the
  //    6 features defined in svm_model.h). The `day` argument is only used
  //    by the KNN gate below, never passed to the SVM.
  float svm_pred = svm_predict_brightness(ambient, motion, sin_h, cos_h, period);

  if (out_svm_pred)       *out_svm_pred       = svm_pred;
  if (out_correction)     *out_correction     = 0.0f;
  if (out_confidence)     *out_confidence     = 0.0f;
  if (out_min_dist)       *out_min_dist       = INFINITY;
  if (out_neighbors_used) *out_neighbors_used = 0;
  if (out_eligible_count) *out_eligible_count = 0;

  if (training_sample_count == 0) {
    return svm_pred;
  }

  // 2. HARD GATE: same day_of_week AND minute-of-day within window,
  //    PLUS a midnight bridge: a sample on the previous/next day-of-week is
  //    eligible only if BOTH endpoints sit within `window` minutes of 00:00.
  //    Example (window=10): Sat 23:55 <-> Sun 00:05 is allowed; Sat 23:55
  //    <-> Sun 12:00 is not.
  int eligible[MAX_TRAINING_SAMPLES];
  int eligible_count = 0;
  int window = knn_cfg.time_window_min;
  int prev_day = (day + 6) % 7;     // day - 1 mod 7
  int next_day = (day + 1) % 7;     // day + 1 mod 7

  for (int i = 0; i < training_sample_count; i++) {
    const TrainingSample &s = samples_cache[i];
    int s_day = s.day_of_week;
    int s_mod = s.minute_of_day;
    bool keep  = false;

    if (s_day == day) {
      int dt = s_mod - cur_mod;
      if (dt < 0) dt = -dt;
      if (dt <= window) keep = true;
    } else if (s_day == prev_day &&
               s_mod  >= 1440 - window &&    // sample late on previous day
               cur_mod <= window) {           // current is early on this day
      int dt = (1440 - s_mod) + cur_mod;
      if (dt <= window) keep = true;
    } else if (s_day == next_day &&
               s_mod  <= window &&            // sample early on next day
               cur_mod >= 1440 - window) {    // current is late on this day
      int dt = s_mod + (1440 - cur_mod);
      if (dt <= window) keep = true;
    }

    if (keep) eligible[eligible_count++] = i;
  }

  if (out_eligible_count) *out_eligible_count = eligible_count;

  if (eligible_count == 0) {
    // No nearby samples for this exact time/day -> SVM only.
    return svm_pred;
  }

  // 3. Compute distances over ambient+motion for eligible samples.
  float distsq[MAX_TRAINING_SAMPLES];
  for (int e = 0; e < eligible_count; e++) {
    const TrainingSample &s = samples_cache[eligible[e]];
    distsq[e] = knnDistanceSq(ambient, motion, s.ambient_light, s.motion_detected);
  }

  // 4. Pick K nearest among eligible (partial selection sort).
  int k_actual = knn_cfg.k_neighbors;
  if (k_actual > eligible_count) k_actual = eligible_count;

  for (int k = 0; k < k_actual; k++) {
    int min_idx = k;
    for (int j = k + 1; j < eligible_count; j++) {
      if (distsq[j] < distsq[min_idx]) min_idx = j;
    }
    if (min_idx != k) {
      float td = distsq[k];   distsq[k]   = distsq[min_idx];   distsq[min_idx]   = td;
      int   ti = eligible[k]; eligible[k] = eligible[min_idx]; eligible[min_idx] = ti;
    }
  }

  // 5. Gaussian-kernel weighted residual average (residuals are vs SVM).
  float sigma_k        = knn_cfg.sigma_kernel;
  float sigma_c        = knn_cfg.sigma_confidence;
  float two_sigma_k_sq = 2.0f * sigma_k * sigma_k;

  float weight_sum   = 0.0f;
  float residual_sum = 0.0f;

  for (int k = 0; k < k_actual; k++) {
    int idx = eligible[k];
    const TrainingSample &s = samples_cache[idx];

    float s_sin, s_cos; int s_period;
    sampleSvmFeatures(s, &s_sin, &s_cos, &s_period);

    float svm_pred_at_s = svm_predict_brightness(
      s.ambient_light, s.motion_detected,
      s_sin, s_cos, s_period);

    float residual = s.target_brightness - svm_pred_at_s;
    float w        = expf(-distsq[k] / two_sigma_k_sq);

    residual_sum += w * residual;
    weight_sum   += w;
  }

  float correction = (weight_sum > 1e-6f) ? (residual_sum / weight_sum) : 0.0f;

  // 6. Confidence based on distance to nearest neighbour.
  float min_dist_sq = distsq[0];
  float confidence  = expf(-min_dist_sq / (2.0f * sigma_c * sigma_c));

  float final_pred = svm_pred + confidence * correction;
  if (final_pred < 0)   final_pred = 0;
  if (final_pred > 100) final_pred = 100;

  if (out_correction)     *out_correction     = correction;
  if (out_confidence)     *out_confidence     = confidence;
  if (out_min_dist)       *out_min_dist       = sqrtf(min_dist_sq);
  if (out_neighbors_used) *out_neighbors_used = k_actual;

  return final_pred;
}

// ============================================
// SETUP
// ============================================

void setup() {
  Serial.begin(9600);
  while (!Serial) { delay(10); }

  Serial.println(F("==================================="));
  Serial.println(F("LED Controller v4.1 - SVM + KNN (TIME-LOCAL) LEARNING"));
  Serial.println(F("==================================="));

  pinMode(PIR_PIN, INPUT);
  pinMode(LED_PIN, OUTPUT);
  pinMode(LDR_PIN, INPUT);
  pinMode(POT_PIN, INPUT);

  EEPROM.begin(EEPROM_SIZE);

  Serial.print(F("Initializing RTC... "));
  if (!rtc.begin()) {
    Serial.println(F("FAILED"));
    while (1) { delay(1000); }
  }
  Serial.println(F("OK"));

  if (rtc.lostPower()) {
    Serial.println(F("RTC lost power. Setting compile time."));
    rtc.adjust(DateTime(F(__DATE__), F(__TIME__)));
  }

  Serial.print(F("Current Time: "));
  printDateTime(rtc.now());
  Serial.println();

  loadKnnConfig();
  initializeTrainingStorage();

  smoothed_ldr = readLDR();

  Serial.println(F("=== MODEL ==="));
  Serial.print  (F("Base       : SVR ("));
#if SVM_KERNEL_RBF
  Serial.print  (F("RBF kernel, "));
#elif SVM_KERNEL_LINEAR
  Serial.print  (F("linear kernel, "));
#else
  Serial.print  (F("kernel=?, "));
#endif
  Serial.print  (SVM_N_SV);
  Serial.println(F(" support vectors, frozen)"));
  Serial.println(F("Personalize: KNN, gated by same day-of-week + minute window"));
  Serial.println(F("AI layer   : Utility-based agent (non-ML), advisory by default"));

  Serial.println(F("=== Commands ==="));
  Serial.println(F("help, stats, samples, clearsamples, modelinfo, knninfo, resetmodel"));
  Serial.println(F("setk N | setsigma X | setwindow N"));
  Serial.println(F("addsample HH [MM] DD AMBIENT MOTION BRIGHTNESS"));
  Serial.println(F("test      HH [MM] DD AMBIENT MOTION POT"));
  Serial.println(F("utility | utilon | utiloff | setutil C E M [F]  (non-ML AI layer)"));

  Serial.println(F("=== Monitoring Started ==="));
  Serial.println(F("|   Time   | Day | Hour | Ambient | Motion |  SVM  |  Adj | Elig |  ML% | Off | Final% | PWM |"));
}

// ============================================
// LOOP
// ============================================

void loop() {
  unsigned long current_time = millis();

  if (!manual_input_mode && current_time - last_update >= UPDATE_INTERVAL) {
    last_update = current_time;

    DateTime now = rtc.now();

    int hour                 = now.hour();
    int minute               = now.minute();
    int day_of_week          = now.dayOfTheWeek();
    int day_of_week_adjusted = (day_of_week + 6) % 7;

    float ambient_light  = readLDR();
    int   motion_detected = digitalRead(PIR_PIN);

    smoothed_ldr = SMOOTHING_FACTOR * smoothed_ldr +
                   (1 - SMOOTHING_FACTOR) * ambient_light;

    float svm_pred, correction, confidence, min_dist;
    int   neighbors_used, eligible_count;
    float ml_brightness = predict_knn(
      smoothed_ldr, motion_detected, hour, minute,
      day_of_week_adjusted,
      &svm_pred, &correction, &confidence, &min_dist,
      &neighbors_used, &eligible_count);

    manual_offset = readManualOffset();

    // --- Non-ML AI layer: Utility-Based Agent (advisory by default) ---
    // Reads the SAME inputs and uses SVM-KNN's output purely as the comfort
    // anchor. It NEVER alters predict_knn(). When util_apply == false (the
    // default) ai_brightness == ml_brightness, so LED behavior is identical
    // to the SVM-KNN-only build. Toggle with `utilon` / `utiloff`.
    utilityAgentEvaluate(ml_brightness, util_prev_brightness,
                         smoothed_ldr, motion_detected, hour, &g_util_result);
    float ai_brightness  = util_apply ? g_util_result.recommended : ml_brightness;
    util_prev_brightness = ai_brightness;

    float final_brightness = ai_brightness + manual_offset;
    if (final_brightness < 0)   final_brightness = 0;
    if (final_brightness > 100) final_brightness = 100;

    smoothed_brightness = SMOOTHING_FACTOR * smoothed_brightness +
                          (1 - SMOOTHING_FACTOR) * final_brightness;

    int pwm_value = map(smoothed_brightness, 0, 100, 0, 255);
    analogWrite(LED_PIN, pwm_value);

    prediction_count++;
    avg_brightness = (avg_brightness * (prediction_count - 1) + final_brightness) / prediction_count;

    char time_str[9];
    sprintf(time_str, "%02d:%02d:%02d", hour, minute, now.second());

    const char *day_names[] = {"Mon", "Tue", "Wed", "Thu", "Fri", "Sat", "Sun"};

    char line[200];
    sprintf(line,
      "| %s | %3s | %2d | %6.1f |   %d   | %4.1f | %+5.1f |  %2d  | %4.1f | %+3d | %5.1f | %3d |",
      time_str,
      day_names[day_of_week_adjusted],
      hour,
      smoothed_ldr,
      motion_detected,
      svm_pred,
      confidence * correction,
      eligible_count,
      ml_brightness,
      manual_offset,
      final_brightness,
      pwm_value);
    Serial.println(line);

    monitorPotForSampleCapture(current_time, ml_brightness, final_brightness);
    checkDailyRollover(now);
  }

  if (Serial.available()) {
    handleSerialCommand();
  }
}

// ============================================
// SENSOR READS
// ============================================

float readLDR() {
  long sum = 0;
  for (int i = 0; i < 20; i++) {
    sum += analogRead(LDR_PIN);
    delay(2);
  }
  float avg     = sum / 20.0f;
  float voltage = (avg / 4095.0f) * 3.3f;

  if (voltage <= 0.01f) return 0;

  float r_ldr = 10000.0f * voltage / (3.3f - voltage);
  float lux   = 32768000.0f * powf(r_ldr, -1.4f);
  if (lux < 0)        lux = 0;
  if (lux > 100000.0) lux = 100000.0;
  return lux;
}

int readManualOffset() {
  int pot_value = analogRead(POT_PIN);
  int center    = 2048;

  if (pot_value >= center - POT_DEADZONE && pot_value <= center + POT_DEADZONE) {
    return 0;
  }
  if (pot_value < center - POT_DEADZONE) {
    return map(pot_value, 0, center - POT_DEADZONE, -100, 0);
  }
  return map(pot_value, center + POT_DEADZONE, 4095, 0, 100);
}

// ============================================
// HOUR -> time_of_day_enc
// Returns the SVM-trained LabelEncoder index for the given hour, using the
// TOD_* macros emitted into svm_model.h. The fallback covers builds where
// the model was trained on a non-standard label set.
// ============================================
int getTimePeriod(int hour) {
#if defined(TOD_NIGHT) && defined(TOD_EARLY_MORNING) && defined(TOD_MORNING) \
 && defined(TOD_AFTERNOON) && defined(TOD_EVENING)
  if (hour >= 4 && hour <= 6)  return TOD_EARLY_MORNING;
  if (hour >  6 && hour <= 12) return TOD_MORNING;
  if (hour > 12 && hour <= 16) return TOD_AFTERNOON;
  if (hour > 16 && hour <= 20) return TOD_EVENING;
  return TOD_NIGHT;
#else
  // Fallback when the training set used different time-of-day strings:
  // mirror the hour bucketing originally used by DT.ino.
  if (hour >= 4 && hour <= 6)  return 0;
  if (hour >  6 && hour <= 12) return 1;
  if (hour > 12 && hour <= 16) return 2;
  if (hour > 16 && hour <= 20) return 3;
  return 4;
#endif
}

// ============================================
// POT-BASED SAMPLE CAPTURE
// ============================================

void monitorPotForSampleCapture(unsigned long current_time,
                                float ml_pred, float user_brightness) {
  int current_pot_raw = analogRead(POT_PIN);

  if (pot_candidate_active) {
    if (abs(current_pot_raw - current_pot_candidate) <= POT_CHANGE_THRESHOLD) {
      if (current_time - pot_stable_start >= POT_STABLE_DURATION) {
        if (last_stable_pot_value == -1 ||
            abs(current_pot_raw - last_stable_pot_value) > POT_CHANGE_THRESHOLD) {

          last_stable_pot_value = current_pot_raw;
          pot_candidate_active  = false;
          pot_change_count_today++;

          if (abs(manual_offset) > 5) {
            captureTrainingSample(ml_pred, user_brightness);
          }

          Serial.print(F("[note] Pot change #"));
          Serial.println(pot_change_count_today);
        }
      }
    } else {
      current_pot_candidate = current_pot_raw;
      pot_stable_start      = current_time;
    }
  } else {
    if (last_stable_pot_value == -1) {
      last_stable_pot_value = current_pot_raw;
    } else if (abs(current_pot_raw - last_stable_pot_value) > POT_CHANGE_THRESHOLD) {
      pot_candidate_active  = true;
      current_pot_candidate = current_pot_raw;
      pot_stable_start      = current_time;
    }
  }
}

void checkDailyRollover(DateTime &now) {
  int current_day = now.day();
  if (last_check_day != -1 && current_day != last_check_day) {
    pot_change_count_today = 0;
  }
  last_check_day = current_day;
}

// ============================================
// COMMAND HELPERS
// ============================================

// Tokenize a String by whitespace into out[0..max-1].
// Returns the number of tokens found (capped at max).
static int tokenizeArgs(const String &s, String *out, int max_tokens) {
  int count = 0;
  int len   = s.length();
  int i     = 0;
  while (i < len && count < max_tokens) {
    while (i < len && (s[i] == ' ' || s[i] == '\t')) i++;
    if (i >= len) break;
    int start = i;
    while (i < len && s[i] != ' ' && s[i] != '\t') i++;
    out[count++] = s.substring(start, i);
  }
  return count;
}

// ============================================
// COMMAND IMPLEMENTATIONS
// ============================================

void testManualPrediction(int hour, int minute, int day, float ambient,
                          int motion, int pot_value) {
  int center = 2048;
  int offset = 0;
  if (pot_value < center - POT_DEADZONE) {
    offset = map(pot_value, 0, center - POT_DEADZONE, -100, 0);
  } else if (pot_value > center + POT_DEADZONE) {
    offset = map(pot_value, center + POT_DEADZONE, 4095, 0, 100);
  }

  float svm_pred, correction, confidence, min_dist;
  int   neighbors_used, eligible_count;
  float knn_pred = predict_knn(ambient, motion, hour, minute, day,
                               &svm_pred, &correction, &confidence,
                               &min_dist, &neighbors_used, &eligible_count);

  float svm_final = svm_pred + offset;
  if (svm_final < 0) svm_final = 0; if (svm_final > 100) svm_final = 100;
  float knn_final = knn_pred + offset;
  if (knn_final < 0) knn_final = 0; if (knn_final > 100) knn_final = 100;

  const char *day_names[]    = {"Mon", "Tue", "Wed", "Thu", "Fri", "Sat", "Sun"};
  const char *period_names[] = {"Early Morning", "Morning", "Afternoon", "Evening", "Night"};

  Serial.println();
  Serial.println(F("=== MANUAL PREDICTION TEST ==="));
  Serial.print(F("  Time : ")); Serial.print(hour); Serial.print(F(":"));
  if (minute < 10) Serial.print('0'); Serial.print(minute);
  // period_names[] is keyed by the DT-style ordering; getTimePeriod() may
  // return a LabelEncoder index. Print the hour bucket name without
  // assuming the indices match.
  int period_idx_hint;
  if (hour >= 4 && hour <= 6)       period_idx_hint = 0;
  else if (hour >  6 && hour <= 12) period_idx_hint = 1;
  else if (hour > 12 && hour <= 16) period_idx_hint = 2;
  else if (hour > 16 && hour <= 20) period_idx_hint = 3;
  else                              period_idx_hint = 4;
  Serial.print(F(" (")); Serial.print(period_names[period_idx_hint]); Serial.println(F(")"));
  Serial.print(F("  Day  : ")); Serial.println(day_names[day]);
  Serial.print(F("  Light: ")); Serial.print(ambient); Serial.println(F(" lux"));
  Serial.print(F("  Motion:")); Serial.println(motion ? F("YES") : F("NO"));
  Serial.print(F("  Pot  : ")); Serial.print(pot_value);
  Serial.print(F(" (offset ")); Serial.print(offset); Serial.println(F("%)"));

  Serial.println();
  Serial.println(F("Model breakdown:"));
  Serial.print(F("  SVM raw           : ")); Serial.println(svm_pred, 2);
  Serial.print(F("  Eligible samples  : ")); Serial.print(eligible_count);
  Serial.print(F(" (within +/-")); Serial.print(knn_cfg.time_window_min);
  Serial.println(F(" min on same day)"));
  Serial.print(F("  Neighbors used    : ")); Serial.println(neighbors_used);
  Serial.print(F("  KNN correction    : ")); Serial.println(correction, 2);
  Serial.print(F("  Confidence        : ")); Serial.println(confidence, 3);
  Serial.print(F("  KNN raw output    : ")); Serial.println(knn_pred, 2);
  Serial.print(F("  Min distance      : "));
  if (isinf(min_dist)) Serial.println(F("inf (no eligible samples)"));
  else                 Serial.println(min_dist, 4);

  Serial.println();
  Serial.print(F("  Final w/ pot : svm=")); Serial.print(svm_final, 2);
  Serial.print(F("%  knn="));               Serial.print(knn_final, 2);
  Serial.println(F("%"));
  Serial.println();
}

void cmdSamples() {
  Serial.println();
  Serial.println(F("=== TRAINING SAMPLES ==="));
  if (training_sample_count == 0) {
    Serial.println(F("No samples yet."));
    Serial.println();
    return;
  }
  const char *day_names[] = {"Mon", "Tue", "Wed", "Thu", "Fri", "Sat", "Sun"};

  Serial.print(F("Total: "));
  Serial.println(training_sample_count);
  Serial.println(F(" #  | Time  | Day | Ambient | Mot | Target% | Timestamp"));
  for (int i = 0; i < training_sample_count; i++) {
    const TrainingSample &s = samples_cache[i];
    int hh = s.minute_of_day / 60;
    int mm = s.minute_of_day % 60;
    char line[100];
    sprintf(line, "%2d  | %02d:%02d | %3s | %7.1f |  %d  | %6.1f  | %lu",
      i + 1, hh, mm,
      day_names[s.day_of_week],
      s.ambient_light, s.motion_detected,
      s.target_brightness, (unsigned long)s.timestamp);
    Serial.println(line);
  }
  Serial.println();
}

void cmdKnnInfo() {
  Serial.println();
  Serial.println(F("=== KNN CONFIG ==="));
  Serial.print(F("  K (neighbors)        : ")); Serial.println(knn_cfg.k_neighbors);
  Serial.print(F("  sigma_kernel         : ")); Serial.println(knn_cfg.sigma_kernel, 4);
  Serial.print(F("  sigma_confidence     : ")); Serial.println(knn_cfg.sigma_confidence, 4);
  Serial.print(F("  Time window (+/-)    : ")); Serial.print(knn_cfg.time_window_min); Serial.println(F(" min"));
  Serial.print(F("  Stored samples       : ")); Serial.println(training_sample_count);
  Serial.println(F("  Eligibility gate     : same day_of_week AND |dt| <= window"));
  Serial.println(F("                         OR adjacent-day midnight bridge"));
  Serial.println(F("  Distance metric      : ambient + motion (within-gate only)"));
  Serial.print(F("  AMBIENT_SCALE        : ")); Serial.println(AMBIENT_SCALE);
  Serial.println();
}

void cmdModelInfo() {
  Serial.println();
  Serial.println(F("=== MODEL INFO ==="));
  Serial.print  (F("Base model     : SVR ("));
#if SVM_KERNEL_RBF
  Serial.print  (F("RBF kernel"));
#elif SVM_KERNEL_LINEAR
  Serial.print  (F("linear kernel"));
#else
  Serial.print  (F("kernel=?"));
#endif
  Serial.print  (F(", "));
  Serial.print  (SVM_N_SV);
  Serial.print  (F(" SVs, "));
  Serial.print  (SVM_N_FEATURES);
  Serial.println(F(" features, FROZEN)"));
  Serial.print  (F("SVM gamma      : ")); Serial.println(SVM_GAMMA, 6);
  Serial.print  (F("SVM intercept  : ")); Serial.println(SVM_INTERCEPT, 6);
  Serial.print  (F("MAX_LUX        : ")); Serial.println(SVM_MAX_LUX, 2);
  Serial.println(F("Correction     : KNN residual over user samples"));
  Serial.println(F("Gating         : same day_of_week + minute_of_day window"));
  Serial.print  (F("Window         : +/-"));
  Serial.print  (knn_cfg.time_window_min); Serial.println(F(" min"));
  Serial.print  (F("Stored samples : ")); Serial.println(training_sample_count);
  Serial.print  (F("Personalization: "));
  Serial.println(training_sample_count > 0 ? F("ACTIVE (SVM + KNN)")
                                           : F("INACTIVE (SVM only - no samples)"));
  Serial.println();
}

void cmdStats() {
  Serial.println();
  Serial.println(F("=== STATS ==="));
  Serial.print(F("Total predictions : ")); Serial.println(prediction_count);
  Serial.print(F("Average brightness: ")); Serial.print(avg_brightness); Serial.println(F("%"));
  Serial.print(F("Pot changes today : ")); Serial.println(pot_change_count_today);
  Serial.print(F("Stored samples    : ")); Serial.println(training_sample_count);
  Serial.print(F("Personalization   : "));
  Serial.println(training_sample_count > 0 ? F("ACTIVE") : F("INACTIVE"));
  Serial.println();
}

void cmdHelp() {
  Serial.println();
  Serial.println(F("=== COMMANDS ==="));
  Serial.println(F("help            - this message"));
  Serial.println(F("stats           - runtime statistics"));
  Serial.println(F("samples         - list stored user samples"));
  Serial.println(F("clearsamples    - wipe samples only (keeps K/sigma/window)"));
  Serial.println(F("resetmodel      - wipe samples AND restore default K/sigma/window"));
  Serial.println(F("modelinfo       - model summary"));
  Serial.println(F("knninfo         - KNN configuration"));
  Serial.println(F("setk N          - K neighbors (1..MAX)"));
  Serial.println(F("setsigma X      - kernel bandwidth (>0)"));
  Serial.println(F("setwindow N     - time window in minutes (1..720)"));
  Serial.println(F(""));
  Serial.println(F("addsample HH DD AMBIENT MOTION BRIGHTNESS"));
  Serial.println(F("                  HH=0..23, DD=0(Mon)..6(Sun)"));
  Serial.println(F("                  minute defaults to 00"));
  Serial.println(F("addsample HH MM DD AMBIENT MOTION BRIGHTNESS"));
  Serial.println(F("                  with explicit minute (MM=0..59)"));
  Serial.println(F("test HH DD AMBIENT MOTION POT"));
  Serial.println(F("test HH MM DD AMBIENT MOTION POT"));
  Serial.println(F("                  POT raw 0..4095 (2048=center)"));
  Serial.println(F(""));
  Serial.println(F("--- Non-ML AI layer (Utility-Based Agent) ---"));
  Serial.println(F("utility            - show last AI utility breakdown"));
  Serial.println(F("utilon             - let the AI layer drive the LED"));
  Serial.println(F("utiloff            - AI layer advisory only (default)"));
  Serial.println(F("setutil C E M [F]  - weights comfort energy smooth [+floor%]"));
  Serial.println();
}

// ============================================
// SERIAL COMMAND DISPATCH
// ============================================

void handleSerialCommand() {
  String command = Serial.readStringUntil('\n');
  command.trim();

  if (command == "help") {
    cmdHelp();
  }
  else if (command == "stats") {
    cmdStats();
  }
  else if (command == "samples") {
    cmdSamples();
  }
  else if (command == "modelinfo") {
    cmdModelInfo();
  }
  else if (command == "knninfo") {
    cmdKnnInfo();
  }
  else if (command == "clearsamples") {
    // Wipe ONLY the stored user samples; keep current K / sigma / window.
    wipeAllSamples();
    Serial.println();
    Serial.println(F("[v] All user samples cleared."));
    Serial.println(F("    KNN config (K, sigma, window) preserved."));
    Serial.println(F("    SVM-only mode is now active until new samples arrive."));
    Serial.println();
  }
  else if (command == "resetmodel") {
    // Full reset: wipe samples AND restore default KNN config.
    wipeAllSamples();
    initializeKnnConfig();
    saveKnnConfig();
    Serial.println();
    Serial.println(F("[v] Full model reset:"));
    Serial.println(F("    - all user samples cleared"));
    Serial.println(F("    - K, sigma_kernel, sigma_confidence, time_window restored to defaults"));
    Serial.print  (F("    - K=")); Serial.print(knn_cfg.k_neighbors);
    Serial.print  (F(" sigma_k=")); Serial.print(knn_cfg.sigma_kernel, 3);
    Serial.print  (F(" sigma_c=")); Serial.print(knn_cfg.sigma_confidence, 3);
    Serial.print  (F(" window=+/-")); Serial.print(knn_cfg.time_window_min); Serial.println(F(" min"));
    Serial.println();
  }
  else if (command.startsWith("setk ")) {
    int k = command.substring(5).toInt();
    if (k < 1 || k > MAX_TRAINING_SAMPLES) {
      Serial.print(F("[x] K must be 1..")); Serial.println(MAX_TRAINING_SAMPLES);
    } else {
      knn_cfg.k_neighbors = k;
      saveKnnConfig();
      Serial.print(F("[v] K set to ")); Serial.println(k);
    }
  }
  else if (command.startsWith("setsigma ")) {
    float s = command.substring(9).toFloat();
    if (s <= 0.0f) {
      Serial.println(F("[x] sigma must be > 0"));
    } else {
      knn_cfg.sigma_kernel = s;
      saveKnnConfig();
      Serial.print(F("[v] sigma_kernel set to ")); Serial.println(s, 4);
    }
  }
  else if (command.startsWith("setwindow ")) {
    int w = command.substring(10).toInt();
    if (w < 1 || w > 720) {
      Serial.println(F("[x] window must be 1..720 minutes"));
    } else {
      knn_cfg.time_window_min = w;
      saveKnnConfig();
      Serial.print(F("[v] time window set to +/-"));
      Serial.print(w); Serial.println(F(" min"));
    }
  }
  else if (command.startsWith("addsample ")) {
    String args = command.substring(10);
    args.trim();

    String tok[8];
    int n = tokenizeArgs(args, tok, 8);

    int   hh = 0, mm = 0, dd = 0, mot = 0;
    float amb = 0.0f, br = 0.0f;

    if (n == 6) {
      // HH MM DD AMBIENT MOTION BRIGHTNESS
      hh  = tok[0].toInt();
      mm  = tok[1].toInt();
      dd  = tok[2].toInt();
      amb = tok[3].toFloat();
      mot = tok[4].toInt();
      br  = tok[5].toFloat();
    } else if (n == 5) {
      // HH DD AMBIENT MOTION BRIGHTNESS  (minute defaults to 0)
      hh  = tok[0].toInt();
      mm  = 0;
      dd  = tok[1].toInt();
      amb = tok[2].toFloat();
      mot = tok[3].toInt();
      br  = tok[4].toFloat();
    } else {
      Serial.print(F("[x] Expected 5 or 6 numeric arguments after 'addsample', got "));
      Serial.println(n);
      Serial.println(F("    addsample HH DD AMBIENT MOTION BRIGHTNESS         (5 args)"));
      Serial.println(F("    addsample HH MM DD AMBIENT MOTION BRIGHTNESS      (6 args)"));
      return;
    }

    if (hh < 0  || hh > 23)        { Serial.print(F("[x] Hour 0..23, got "));        Serial.println(hh);  return; }
    if (mm < 0  || mm > 59)        { Serial.print(F("[x] Minute 0..59, got "));      Serial.println(mm);  return; }
    if (dd < 0  || dd > 6)         { Serial.print(F("[x] Day 0..6 (0=Mon..6=Sun), got ")); Serial.println(dd); return; }
    if (amb < 0 || amb > 100000)   { Serial.print(F("[x] Ambient 0..100000 lux, got ")); Serial.println(amb); return; }
    if (mot != 0 && mot != 1)      { Serial.print(F("[x] Motion 0 or 1, got "));     Serial.println(mot); return; }
    if (br < 0  || br > 100)       { Serial.print(F("[x] Brightness 0..100, got ")); Serial.println(br);  return; }

    addManualSample(hh, mm, dd, amb, mot, br);
  }
  else if (command.startsWith("test ")) {
    String args = command.substring(5);
    args.trim();

    String tok[8];
    int n = tokenizeArgs(args, tok, 8);

    int   hh = 0, mm = 0, dd = 0, mot = 0, pot = 0;
    float amb = 0.0f;

    if (n == 6) {
      // HH MM DD AMBIENT MOTION POT
      hh  = tok[0].toInt();
      mm  = tok[1].toInt();
      dd  = tok[2].toInt();
      amb = tok[3].toFloat();
      mot = tok[4].toInt();
      pot = tok[5].toInt();
    } else if (n == 5) {
      // HH DD AMBIENT MOTION POT  (minute defaults to 0)
      hh  = tok[0].toInt();
      mm  = 0;
      dd  = tok[1].toInt();
      amb = tok[2].toFloat();
      mot = tok[3].toInt();
      pot = tok[4].toInt();
    } else {
      Serial.print(F("[x] Expected 5 or 6 numeric arguments after 'test', got "));
      Serial.println(n);
      Serial.println(F("    test HH DD AMBIENT MOTION POT         (5 args)"));
      Serial.println(F("    test HH MM DD AMBIENT MOTION POT      (6 args)"));
      return;
    }

    if (hh < 0  || hh > 23)        { Serial.print(F("[x] Hour 0..23, got "));        Serial.println(hh);  return; }
    if (mm < 0  || mm > 59)        { Serial.print(F("[x] Minute 0..59, got "));      Serial.println(mm);  return; }
    if (dd < 0  || dd > 6)         { Serial.print(F("[x] Day 0..6 (0=Mon..6=Sun), got ")); Serial.println(dd); return; }
    if (amb < 0 || amb > 100000)   { Serial.print(F("[x] Ambient 0..100000 lux, got ")); Serial.println(amb); return; }
    if (mot != 0 && mot != 1)      { Serial.print(F("[x] Motion 0 or 1, got "));     Serial.println(mot); return; }
    if (pot < 0 || pot > 4095)     { Serial.print(F("[x] Pot 0..4095, got "));       Serial.println(pot); return; }

    testManualPrediction(hh, mm, dd, amb, mot, pot);
  }
  else if (command == "utility") {
    // Non-ML AI layer: show the last utility-based evaluation + breakdown.
    utilityAgentPrint(g_util_result);
  }
  else if (command == "utilon") {
    util_apply = true;
    Serial.println();
    Serial.println(F("[v] Utility agent ENABLED - it now drives the LED."));
    Serial.println(F("    (SVM-KNN output is used as the comfort anchor.)"));
    Serial.println();
  }
  else if (command == "utiloff") {
    util_apply = false;
    Serial.println();
    Serial.println(F("[v] Utility agent ADVISORY only - SVM-KNN drives the LED."));
    Serial.println(F("    (Default. Use 'utility' to view its recommendation.)"));
    Serial.println();
  }
  else if (command.startsWith("setutil ")) {
    // setutil COMFORT ENERGY SMOOTH [MINSAFE]
    //   COMFORT/ENERGY/SMOOTH : soft utility weights (>= 0)
    //   MINSAFE (optional)    : hard night-motion safety floor 0..100 (%)
    String args = command.substring(8);
    args.trim();

    String tok[8];
    int n = tokenizeArgs(args, tok, 8);

    if (n != 3 && n != 4) {
      Serial.println(F("[x] Usage: setutil COMFORT ENERGY SMOOTH [MINSAFE]"));
      Serial.println(F("    weights >= 0 ; optional MINSAFE 0..100 (night-motion floor)"));
      return;
    }

    float wc = tok[0].toFloat();
    float we = tok[1].toFloat();
    float wm = tok[2].toFloat();

    if (wc < 0 || we < 0 || wm < 0) {
      Serial.println(F("[x] Weights must be >= 0"));
      return;
    }

    int ms = g_util_cfg.min_safe_night;
    if (n == 4) {
      ms = tok[3].toInt();
      if (ms < 0 || ms > 100) {
        Serial.println(F("[x] MINSAFE must be 0..100"));
        return;
      }
    }

    g_util_cfg.w_comfort      = wc;
    g_util_cfg.w_energy       = we;
    g_util_cfg.w_smooth       = wm;
    g_util_cfg.min_safe_night = ms;

    Serial.print(F("[v] Utility weights set: comfort=")); Serial.print(wc, 2);
    Serial.print(F(" energy=")); Serial.print(we, 2);
    Serial.print(F(" smooth=")); Serial.print(wm, 2);
    Serial.print(F(" | night-motion floor=")); Serial.print(ms); Serial.println(F("%"));
  }
  else if (command.length() > 0) {
    Serial.print(F("[x] Unknown: ")); Serial.println(command);
    Serial.println(F("Type 'help' for available commands"));
  }
}

// ============================================
// MISC
// ============================================

void printDateTime(DateTime dt) {
  char buffer[25];
  sprintf(buffer, "%04d-%02d-%02d %02d:%02d:%02d",
          dt.year(), dt.month(), dt.day(),
          dt.hour(), dt.minute(), dt.second());
  Serial.print(buffer);
}
